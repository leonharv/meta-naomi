## conf/layer.conf
```bitbake
# We have a conf and classes directory, add to BBPATH
BBPATH .= ":${LAYERDIR}"

# We have recipes-* directories, add to BBFILES
BBFILES += "${LAYERDIR}/recipes-*/*/*.bb \
	    ${LAYERDIR}/recipes-*/*/*.bbappend"

BBFILE_COLLECTIONS += "naomi"
BBFILE_PATTERN_naomi = "^${LAYERDIR}/"
BBFILE_PRIORITY_naomi = "6"
LAYERDEPENDS_naomi = "core ros-layer meta-python"
```
